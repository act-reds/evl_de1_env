## buildroot/package/libevl/Config.in
```kconfig
config BR2_PACKAGE_LIBEVL
	bool "libevl"
	help
	  This library implements the system call interface between applications
	  running in user-space and the EVL core,

	  https://evlproject.org/core/user-api/
```

## resources/configs/old_ptr_env_defconfig
```kconfig
BR2_arm=y
BR2_cortex_a9=y
BR2_ARM_ENABLE_NEON=y
BR2_ARM_ENABLE_VFP=y
BR2_ARM_FPU_NEON=y
BR2_PACKAGE_HOST_LINUX_HEADERS_CUSTOM_6_6=y
BR2_TOOLCHAIN_BUILDROOT_CXX=y
BR2_TOOLCHAIN_BUILDROOT_FORTRAN=y
BR2_GCC_ENABLE_OPENMP=y
BR2_TARGET_GENERIC_HOSTNAME="ptr-lab"
BR2_TARGET_GENERIC_ISSUE="Welcome to PTR"
BR2_TARGET_GENERIC_ROOT_PASSWD="root"
BR2_ROOTFS_OVERLAY="../resources/board/rootfs_overlay"
BR2_ROOTFS_POST_BUILD_SCRIPT="../resources/board/de1_soc/setup_before_genimage.sh"
BR2_ROOTFS_POST_IMAGE_SCRIPT="support/scripts/genimage.sh"
BR2_ROOTFS_POST_SCRIPT_ARGS="-c ../resources/board/de1_soc/genimage.cfg"
BR2_LINUX_KERNEL=y
BR2_LINUX_KERNEL_CUSTOM_GIT=y
BR2_LINUX_KERNEL_CUSTOM_REPO_URL="https://source.denx.de/Xenomai/xenomai4/linux-evl.git"
BR2_LINUX_KERNEL_CUSTOM_REPO_VERSION="v6.6.y-evl-rebase"
BR2_LINUX_KERNEL_DEFCONFIG="socfpga"
BR2_LINUX_KERNEL_UIMAGE=y
BR2_LINUX_KERNEL_UIMAGE_LOADADDR="0x00008000"
BR2_LINUX_KERNEL_DTS_SUPPORT=y
BR2_LINUX_KERNEL_CUSTOM_DTS_PATH="../resources/board/dts_overlay/socfpga_cyclone5_de1_soc.dts"
BR2_PACKAGE_OPENSSH=y
BR2_PACKAGE_XENOMAI=y
BR2_PACKAGE_XENOMAI_CUSTOM_GIT=y
BR2_PACKAGE_XENOMAI_REPOSITORY="https://source.denx.de/Xenomai/xenomai"
BR2_PACKAGE_XENOMAI_REPOSITORY_VERSION="stable/v3.1.x"
BR2_PACKAGE_XENOMAI_COBALT=y
BR2_PACKAGE_XENOMAI_ENABLE_REGISTRY=y
BR2_PACKAGE_XENOMAI_ADDITIONAL_CONF_OPTS="--enable-smp"
BR2_PACKAGE_XENOMAI_TESTSUITE=y
BR2_PACKAGE_XENOMAI_ANALOGY=y
BR2_PACKAGE_LIBEVL=y
BR2_TARGET_ROOTFS_EXT2=y
BR2_TARGET_ROOTFS_EXT2_4=y
BR2_TARGET_ROOTFS_EXT2_SIZE="120M"
BR2_TARGET_UBOOT=y
BR2_TARGET_UBOOT_BUILD_SYSTEM_KCONFIG=y
BR2_TARGET_UBOOT_CUSTOM_VERSION=y
BR2_TARGET_UBOOT_CUSTOM_VERSION_VALUE="2018.03"
BR2_TARGET_UBOOT_USE_CUSTOM_CONFIG=y
BR2_TARGET_UBOOT_CUSTOM_CONFIG_FILE="../resources/configs/uboot_ptr_env_defconfig"
BR2_TARGET_UBOOT_NEEDS_DTC=y
BR2_TARGET_UBOOT_FORMAT_IMG=y
BR2_TARGET_UBOOT_SPL=y
BR2_TARGET_UBOOT_ALTERA_SOCFPGA_IMAGE_CRC=y
BR2_PACKAGE_HOST_DOSFSTOOLS=y
BR2_PACKAGE_HOST_GENIMAGE=y
BR2_PACKAGE_HOST_MTOOLS=y
BR2_PACKAGE_HOST_UBOOT_TOOLS_ENVIMAGE=y
BR2_PACKAGE_HOST_UBOOT_TOOLS_ENVIMAGE_SOURCE="../resources/board/de1_soc/boot-env.txt"
BR2_PACKAGE_HOST_UBOOT_TOOLS_ENVIMAGE_SIZE="8192"
```
